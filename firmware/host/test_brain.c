/* Golden-trace parity: the C brain must reproduce scripts/personalize.py (and
 * the server's /api/next context assembly) on fixtures generated by
 * firmware/tools/gen_goldens.py.  Usage: test_brain <pack_dir> <goldens_dir> */
#include <math.h>
#include <stdio.h>
#include <stdlib.h>
#include <string.h>

#include "omp_brain.h"
#include "omp_playlog.h"
#include "omp_speeddial.h"

static int fails;
#define CHECK(cond, ...) do { if (!(cond)) { fails++; printf("FAIL: " __VA_ARGS__); printf("\n"); } } while (0)

static FILE *openf(const char *dir, const char *name)
{
    char p[512];
    snprintf(p, sizeof p, "%s/%s", dir, name);
    FILE *f = fopen(p, "rb");
    if (!f) { printf("FATAL: missing %s\n", p); exit(2); }
    return f;
}

static uint32_t r_u32(FILE *f) { uint32_t v; fread(&v, 4, 1, f); return v; }
static uint16_t r_u16(FILE *f) { uint16_t v; fread(&v, 2, 1, f); return v; }
static uint8_t r_u8(FILE *f) { uint8_t v; fread(&v, 1, 1, f); return v; }
static float r_f32(FILE *f) { float v; fread(&v, 4, 1, f); return v; }
static double r_f64(FILE *f) { double v; fread(&v, 8, 1, f); return v; }

static double rng_const(void *s) { (void)s; return 0.5; }   /* >= eps -> exploit */

int main(int argc, char **argv)
{
    if (argc < 3) { printf("usage: test_brain <pack_dir> <goldens_dir>\n"); return 2; }
    const char *gold = argv[2];
    omp_pack pack;
    if (omp_pack_open(&pack, argv[1], OMP_PACK_LOAD_ALL) != 0) {
        printf("FATAL: pack open\n");
        return 2;
    }

    char logpath[512];
    snprintf(logpath, sizeof logpath, "%s/plays.bin", gold);
    omp_play *plays;
    int n_plays = omp_playlog_load(logpath, &plays);
    CHECK(n_plays > 0, "playlog load (%d)", n_plays);

    /* ---- prefs parity ---- */
    FILE *f = openf(gold, "prefs.bin");
    double now = r_f64(f);
    omp_prefs prefs;
    CHECK(omp_prefs_compute(&pack, plays, n_plays, now, OMP_HALFLIFE_DAYS, &prefs) == 0,
          "prefs compute");
    uint32_t n_tp = r_u32(f);
    int py_nonzero = 0;
    for (uint32_t i = 0; i < n_tp; i++) {
        uint32_t idx = r_u32(f);
        float w = r_f32(f);
        if (w != 0.0f) py_nonzero++;
        float c = omp_map_get(&prefs.track_pref, idx, 0.0f);
        CHECK(fabsf(c - w) < 1e-4f, "track_pref[%u]: c=%f py=%f", idx, c, w);
    }
    int c_nonzero = 0;
    for (uint32_t s = 0; s < prefs.track_pref.cap; s++)
        if (prefs.track_pref.keys[s] != OMP_MAP_EMPTY && prefs.track_pref.vals[s] != 0.0f) c_nonzero++;
    CHECK(c_nonzero == py_nonzero, "nonzero track prefs: c=%d py=%d", c_nonzero, py_nonzero);
    uint32_t n_ap = r_u32(f);
    for (uint32_t i = 0; i < n_ap; i++) {
        uint32_t off = r_u32(f);
        float w = r_f32(f);
        float c = omp_map_get(&prefs.artist_pref, off, 0.0f);
        CHECK(fabsf(c - w) < 1e-4f, "artist_pref[%u]: c=%f py=%f", off, c, w);
    }
    uint32_t n_pc = r_u32(f);
    for (uint32_t i = 0; i < n_pc; i++) {
        uint32_t idx = r_u32(f);
        uint16_t c = r_u16(f);
        float pc = omp_map_get(&prefs.play_counts, idx, 0.0f);
        CHECK(pc == (float)c, "play_counts[%u]: c=%.0f py=%u", idx, pc, c);
    }
    fclose(f);
    printf("prefs: %u tracks, %u artists, %u counts checked\n", n_tp, n_ap, n_pc);

    /* ---- centroid parity ---- */
    f = openf(gold, "centroids.bin");
    float py_taste[OMP_DIM], py_skip[OMP_DIM], c_taste[OMP_DIM], c_skip[OMP_DIM];
    int py_has_taste = r_u8(f);
    for (int d = 0; d < OMP_DIM; d++) py_taste[d] = r_f32(f);
    int py_has_skip = r_u8(f);
    for (int d = 0; d < OMP_DIM; d++) py_skip[d] = r_f32(f);
    fclose(f);
    int c_has_taste = omp_taste_centroid(&pack, &prefs, c_taste);
    int c_has_skip = omp_skip_centroid(&pack, &prefs, c_skip);
    CHECK(c_has_taste == py_has_taste, "taste presence c=%d py=%d", c_has_taste, py_has_taste);
    CHECK(c_has_skip == py_has_skip, "skip presence c=%d py=%d", c_has_skip, py_has_skip);
    if (c_has_taste && py_has_taste) {
        double dot = 0;
        for (int d = 0; d < OMP_DIM; d++) {
            dot += (double)c_taste[d] * py_taste[d];
            CHECK(fabsf(c_taste[d] - py_taste[d]) < 1e-3f, "taste[%d] c=%f py=%f",
                  d, c_taste[d], py_taste[d]);
        }
        CHECK(dot > 0.99999, "taste dot %f", dot);
    }
    if (c_has_skip && py_has_skip) {
        double dot = 0;
        for (int d = 0; d < OMP_DIM; d++)
            dot += (double)c_skip[d] * py_skip[d];
        CHECK(dot > 0.99999, "skip dot %f", dot);
    }
    printf("centroids: taste=%d skip=%d\n", c_has_taste, c_has_skip);

    /* ---- full next-track step parity (context assembly + ranking) ---- */
    f = openf(gold, "ranks.bin");
    (void)r_f64(f);
    uint32_t n_cases = r_u32(f);
    omp_prefs empty;
    omp_prefs_compute(&pack, NULL, 0, now, OMP_HALFLIFE_DAYS, &empty);
    omp_ranked *ranked = malloc((size_t)pack.k * sizeof *ranked);
    double *py_score = malloc((size_t)pack.n * sizeof(double));
    uint8_t *in_py = calloc(pack.n, 1);
    for (uint32_t c = 0; c < n_cases; c++) {
        int pers = r_u8(f);
        uint32_t cur = r_u32(f);
        uint32_t n_played = r_u32(f), n_exp = r_u32(f);
        uint32_t *played = malloc(n_played ? n_played * 4 : 4);
        for (uint32_t i = 0; i < n_played; i++) played[i] = r_u32(f);
        uint32_t *py_order = malloc(n_exp ? n_exp * 4 : 4);
        for (uint32_t i = 0; i < n_exp; i++) {
            py_order[i] = r_u32(f);
            py_score[py_order[i]] = r_f64(f);
            in_py[py_order[i]] = 1;
        }
        omp_pick_reason reason;
        int n_ranked = 0;
        uint32_t pick = omp_next_track(&pack, pers ? &prefs : &empty,
                                       (pers && c_has_taste) ? c_taste : NULL,
                                       (pers && c_has_skip) ? c_skip : NULL,
                                       played, (int)n_played, cur, 0.15,
                                       rng_const, NULL, &reason, ranked, &n_ranked);
        CHECK(pick != UINT32_MAX && reason == OMP_PICK_EXPLOIT, "case %u pick", c);
        CHECK(n_ranked == (int)n_exp, "case %u count c=%d py=%u", c, n_ranked, n_exp);
        int set_ok = 1;
        for (int i = 0; i < n_ranked; i++)
            if (!in_py[ranked[i].idx]) set_ok = 0;
        CHECK(set_ok, "case %u candidate sets differ", c);
        if (n_ranked == (int)n_exp && set_ok) {
            for (int i = 0; i < n_ranked; i++)
                CHECK(fabs(ranked[i].score - py_score[ranked[i].idx]) < 5e-4,
                      "case %u score[%u]: c=%f py=%f", c, ranked[i].idx,
                      ranked[i].score, py_score[ranked[i].idx]);
            for (int i = 1; i < n_ranked; i++)
                CHECK(py_score[ranked[i].idx] <= py_score[ranked[i - 1].idx] + 3e-4,
                      "case %u order break at %d", c, i);
            CHECK(ranked[0].idx == py_order[0] ||
                  fabs(py_score[ranked[0].idx] - py_score[py_order[0]]) < 3e-4,
                  "case %u top-1: c=%u py=%u", c, ranked[0].idx, py_order[0]);
        }
        for (uint32_t i = 0; i < n_exp; i++) in_py[py_order[i]] = 0;
        free(played);
        free(py_order);
    }
    fclose(f);
    printf("rank cases: %u checked\n", n_cases);

    /* ---- speed-dial parity ---- */
    f = openf(gold, "speeddial.bin");
    double sd_now = r_f64(f);
    for (int fresh = 0; fresh <= 1; fresh++) {
        uint32_t n_exp = r_u32(f);
        uint32_t exp_idx[64], got[64];
        for (uint32_t i = 0; i < n_exp; i++) exp_idx[i] = r_u32(f);
        int n_got = omp_speeddial(&pack, plays, n_plays, sd_now, (int)n_exp,
                                  fresh, NULL, NULL, got);
        CHECK(n_got == (int)n_exp, "dial fresh=%d count c=%d py=%u", fresh, n_got, n_exp);
        for (int i = 0; i < n_got && i < (int)n_exp; i++)
            CHECK(got[i] == exp_idx[i], "dial fresh=%d pos %d: c=%u py=%u",
                  fresh, i, got[i], exp_idx[i]);
    }
    fclose(f);
    printf("speed-dial: both modes checked\n");

    free(ranked); free(py_score); free(in_py); free(plays);
    omp_prefs_free(&prefs);
    omp_prefs_free(&empty);
    omp_pack_close(&pack);
    printf(fails ? "test_brain: %d FAILURES\n" : "test_brain: OK — C brain == Python brain\n", fails);
    return fails ? 1 : 0;
}
